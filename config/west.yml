## config/west.yml
```yaml
manifest:
  remotes:
    - name: zmkfirmware
      url-base: https://github.com/zmkfirmware
    - name: tsusuga
      url-base: https://github.com/tsusuga
  projects:
    - name: zmk
      remote: zmkfirmware
      revision: main
      import: app/west.yml
    - name: zmk-pmw3610-driver
      remote: tsusuga
      revision: feature/scroll-acceleration
  self:
    path: config
```
